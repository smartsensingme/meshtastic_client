## CMakeLists.txt
```
# SPDX-License-Identifier: Apache-2.0
cmake_minimum_required(VERSION 3.20.0)
get_filename_component(MESHTASTIC_CLIENT_DIR "${CMAKE_CURRENT_LIST_DIR}/../.." REALPATH)
set(RT_LOG_MODULE_DIR "${MESHTASTIC_CLIENT_DIR}/../rt_log" CACHE PATH "rt_log repository")
list(APPEND ZEPHYR_EXTRA_MODULES "${MESHTASTIC_CLIENT_DIR}" "${RT_LOG_MODULE_DIR}")
find_package(Zephyr REQUIRED HINTS $ENV{ZEPHYR_BASE})
project(meshtastic_minimal)
target_sources(app PRIVATE src/main.c)
```

## prj.conf
```kconfig
CONFIG_SERIAL=y
CONFIG_UART_INTERRUPT_DRIVEN=y
CONFIG_ENTROPY_GENERATOR=y
CONFIG_MESHTASTIC_CLIENT=y
CONFIG_MAIN_STACK_SIZE=4096
CONFIG_LOG=y
CONFIG_LOG_MODE_DEFERRED=y
CONFIG_LOG_BLOCK_IN_THREAD=n
CONFIG_RT_LOG=y
CONFIG_RT_LOG_MAX_LEVEL=3
CONFIG_RT_LOG_DEFAULT_LEVEL=3
CONFIG_MESHTASTIC_PACKET_TRACE=n
CONFIG_MESHTASTIC_REFRESH_INTERVAL_MS=0
```

## boards/qemu_cortex_m3.conf
```kconfig
# Build/simulation only: QEMU target has no hardware entropy source.
# Never use this test generator as a source of cryptographic keys.
CONFIG_TEST_RANDOM_GENERATOR=y
```

## boards/qemu_cortex_m3.overlay
```dts
/* SPDX-License-Identifier: Apache-2.0 */
/* Build-only portability target: console uses UART0, client exclusively UART1. */
/ {
    aliases {
        meshtastic-uart = &uart1;
    };
};
&uart1 {
    status = "okay";
    current-speed = <115200>;
};
```

## src/main.c
```c
/* SPDX-License-Identifier: Apache-2.0 */
#include <stdint.h>

#include <zephyr/device.h>
#include <zephyr/kernel.h>

#include <meshtastic_client/client.h>
#include <rt_log/log.h>

RT_LOG_MODULE_REGISTER(mesh_minimal);
static const char *const LOG_TAG = "MESH_EXAMPLE";

/** Callback interno chamado por event do cliente na thread main.
 * Só consome campos emprestados durante a chamada, sem novo comando ao rádio.
 */
static void on_radio(const struct mc_event *event)
{
	switch (event->type) {
	case MC_SYNCED:
		RT_LOGI(LOG_TAG, "Radio synced local=!%08x", event->node);
		break;
	case MC_DISCONNECTED:
		RT_LOGW(LOG_TAG, "Radio disconnected");
		break;
	case MC_RECEIVED:
		RT_LOGI(LOG_TAG, "RX from=!%08x port=%u bytes=%u", event->node, event->port,
			(unsigned)event->length);
		break;
	case MC_ERROR:
		RT_LOGE(LOG_TAG, "Radio error=%d", event->status);
		break;
	default:
		break;
	}
}

/** Entrada externa Zephyr; único dono do cliente, sem sensor/CONC/reporter/USB.
 * O alias UART pertence ao consumidor; sem transmissão periódica de aplicação.
 */
int main(void)
{
	int rc = mc_init(DEVICE_DT_GET(DT_ALIAS(meshtastic_uart)), on_radio);
	if (rc) {
		RT_LOGE(LOG_TAG, "UART init=%d", rc);
		return rc;
	}

	for (;;) {
		mc_poll();
		mc_wait(INT32_MAX);
	}
	return 0;
}
```
